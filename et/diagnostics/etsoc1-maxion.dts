// SPDX-License-Identifier: Apache-2.0
// Copyright (c) 2025 Ainekko, Co.
//
// OpenSBI fw_payload + payload_hello.S: 2 MiB inside the SP "DM scratch" region
// (0x80_0400_1000 .. +4 MiB), i.e. BAR0 offset 0x1FF000 from the host, DRAM low OS
// sub-region.  Nothing else in the ET software stack uses it outside of a
// firmware update.  Linux uses ../linux/etsoc1-maxion-linux.dts instead.
/dts-v1/;
#include "etsoc1-maxion.dtsi"

/ {
	chosen {
		/* earlycon=sbi keeps Linux from reprogramming the UART divisor
		   with an integer value (see the uart1 node). */
		bootargs = "console=ttyS0,115200n8 earlycon=sbi";
	};

	memory@8004200000 {
		device_type = "memory";
		reg = <0x80 0x04200000 0x0 0x00200000>;
	};
};
